/*@!Encoding:1252*/
includes
{
  #include "NewFile1.cin"
}



variables
{
  dword gPortNo=2; /*COM1*/
  dword  gBaudRate=9600;
  dword  gDataBits=8;
  dword  gStopBits=2;
  dword  gParity = 0;/*0-NOPARITY,1-ODDPARITY,2-EVENPARITY*/
  int iterator;
  double Get_Volt;
  
  
  
    int i=0;
    double x=0;
    char tVoltage_check[100];  
    byte tSendbuffer[500];
  int tlength,titerator;
  long low_int, high_int;
  //Checking
  char h[100];
   char tVoltage[20];
  
  // GLOBAL
  const int kBUFFER_SIZE = 1000;
  const int kINFO        = 1;
  const int kWARN        = 2;
  const int kERROR       = 3;
  // data is copied from callback buffer to gReceiverBuffer (collects data)
  byte gReceiverCallbackBuffer[kBUFFER_SIZE];

  byte gReceiverBuffer[kBUFFER_SIZE];
  byte gEmptyBuffer   [kBUFFER_SIZE];
  long gNumberOfReceivedBytes = 0;
  char StrData[100],StrData2[100];
 char Readvoltage[20]="MEAS:VOLT?\r";
  char ReadCurrent[20]="MEAS:CURR?\r";
  // state variable
  byte gSending = 0;
}

on preStart
{
 InitSerialPort();
}       

on sysvar_update measure::vol
{
  if (@measure::vol>Vol_ul)
  {
    write("OverCharge");
    con=0;
  }
}

/*
on sysvar measure::SetMEACur
{
  char LastCommand[20] = "Current Read";
  int iterator; 
 byte Sendbuffer[500];
  
  int length;
 
  double Get_Current;
  byte Sendbuffer1[500];
  if(@measure::SetMEACur ==0) 
  {
   @measure::SetMEACur = 1;
     
  length=strlen(ReadCurrent);
  write("length %d",length);
  for(iterator=0;iterator<length;iterator++)
  Sendbuffer1[iterator]=ReadCurrent[iterator];
  RS232Send(gPortNo,Sendbuffer1,length);
  for(iterator=0;iterator<gNumberOfReceivedBytes;iterator++)
  StrData2[iterator]=gReceiverBuffer[iterator];
  
   
  // reset buffer
  gNumberOfReceivedBytes = 0;
  
  Get_Current=atodbl(StrData2);
//  write("Current Read= %f",Get_Current);

  @measure::cur = Get_Current;
 
 
  }
}
*/

void InitSerialPort()
{

  if(Rs232Close(gPortNo)==1)
    writeLineEx(0,kINFO, "Serial port %d successfully closed.", gPortNo);    
  else
    writeLineEx(0,kERROR,"An error occurred during closing of the serial port %d.", gPortNo);    

  // set state (close aborts all open requests)
  gSending = 0;
  
  // open the serial port (comes up with Windows defaults)
  if(Rs232Open(gPortNo)==1)
    writeLineEx(0,kINFO, "Serial port %d successfully opened.", gPortNo);    
  else
    writeLineEx(0,kERROR,"An error occurred during opening of the serial port %d.", gPortNo);
  
  // configure the serial port
  // - just take the panel content
  if(Rs232Configure(gPortNo,gBaudRate,gDataBits,gStopBits,gParity)==1)
    writeLineEx(0,kINFO, "Serial port %d successfully initialized.", gPortNo);    
  else
    writeLineEx(0,kERROR,"An error occurred during initialization of the serial port %d.", gPortNo); 

  // set buffer for reception (otherwise callback would not work)
  if(Rs232Receive(gPortNo, gReceiverCallbackBuffer, kBUFFER_SIZE))
    writeLineEx(0,kINFO, "Receiver buffer for serial port %d successfully set.", gPortNo);    
  else
    writeLineEx(0,kERROR,"An error occurred during setting the receiver buffer for serial port %d.", gPortNo);
  
  Rs232SetHandshake(gPortNo,128,0,0,0,0);
}



RS232OnReceive(dword port, byte buffer1[], dword number)
{
  char StrData[20];
  dword numberOfBytesToCopy;
  numberOfBytesToCopy = number;
  
  write("Callback function called"); 
  
  if ( numberOfBytesToCopy==0 )
  {
    return; // nothing to add
  }
  
  CopyBuffer(gReceiverBuffer,gNumberOfReceivedBytes,buffer1,numberOfBytesToCopy);
  gNumberOfReceivedBytes += numberOfBytesToCopy; 
  
  for(iterator=0;iterator<gNumberOfReceivedBytes;iterator++)
  StrData[iterator]=gReceiverBuffer[iterator];
  
  StrData[iterator-1]='\0';  
  gNumberOfReceivedBytes = 0;
  
  Get_Volt=atodbl(StrData);
 
  @measure::vol = Get_Volt;
 }

CopyBuffer( byte destBuffer[], dword destOffset, byte srcBuffer[], dword srcNumber )
{
  dword i;

  for (i=0; i<srcNumber; i++)
  {
    destBuffer[destOffset+i] = srcBuffer[i];
  }
}


Rs232OnSend( dword port, byte buffer[], dword number )
{
  // set state
  gSending = 0;

  writeLineEx(0,kINFO,"Transmission of %d bytes from port %d completed !", number, port);
}



RS232OnError( dword port, dword errorFlags )
{
  // set state
  gSending = 0;

  writeLineEx(0,kERROR,"Error handler called with error code %d !", errorFlags);

  if ( errorFlags & 1 )
    writeLineEx(0,1,"%d informs of send error",errorFlags);
  if ( errorFlags & 2 )
    writeLineEx(0,1,"%d informs of receive error",errorFlags);
  if ( errorFlags & 4 )
    writeLineEx(0,1,"%d informs of frame error",errorFlags);
  if ( errorFlags & 8 )
    writeLineEx(0,1,"%d informs of parity error",errorFlags);
  if ( errorFlags & 16 )
    writeLineEx(0,1,"%d informs of overrun error",errorFlags);
  if ( errorFlags & 32 )
    writeLineEx(0,1,"%d informs of receiver overrun error",errorFlags);
  if ( errorFlags & 64 )
    writeLineEx(0,1,"%d informs of break state",errorFlags);
  if ( errorFlags & 128 )
    writeLineEx(0,1,"%d informs of send timeout error",errorFlags);
}